## conf/distro/fslc.conf
```bitbake
DISTRO = "fslc"
DISTRO_NAME = "Freescale Linux Community Edition"

DISTRO_FEATURES = "systemd"
ACCEPT_FSL_EULA = "1"
```

## conf/machine/imx943-19x19-lpddr5-evk.conf
```bitbake
#@TYPE: Machine
#@NAME: NXP i.MX 943 19x19 Evaluation Kit with LPDDR5
#@SOC: i.MX943
#@DESCRIPTION: Machine configuration for NXP i.MX 943 19x19 EVK with LPDDR5
#@MAINTAINER: Jun Zhu <junzhu@nxp.com>

require conf/machine/include/imx943-evk.inc

KERNEL_DEVICETREE:append:use-nxp-bsp = " \
"

UBOOT_CONFIG_BASENAME = "imx943_evk"

OEI_BOARD  ?= "mx943lp5-19"
DDR_TYPE   = "lpddr5"
DDR_FIRMWARE_NAME = " \
    lpddr5_dmem_v202409.bin \
    lpddr5_dmem_qb_v202409.bin \
    lpddr5_imem_v202409.bin \
    lpddr5_imem_qb_v202409.bin \
"

OEI_DDR_CONFIG     = "MIMX943_LPDDR5_EVK_19X19_4266MTS_FW2024.09_timing"
OEI_DDR_CONFIG_ECC = "MIMX943_LPDDR5_EVK_19X19_4266MTS_FW2024.09_ECC_enabled_timing"

# this is already declared in imx943-evk.inc
# SYSTEM_MANAGER_FIRMWARE_BASENAME ?= "m33_image"
# SYSTEM_MANAGER_CONFIG ?= "imx943-evk"

# The System Manager Firmware Name corresponds to a particular binary implementation
# in the Yocto deploy folder. The default name is comprised of the Firmware Basename
# and the default system manager Config name, e.g., m33_image-mx95evk.bin and
# m33_image-mx95evk_fusa.bin for the standard BSP version and FuSa version, respectively
SYSTEM_MANAGER_FIRMWARE_NAME ?= "${SYSTEM_MANAGER_FIRMWARE_BASENAME}-${SYSTEM_MANAGER_CONFIG}"
```
